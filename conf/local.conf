## conf/local.conf
```bitbake
BB_NUMBER_THREADS ?= "${@oe.utils.cpu_count()}"
PARALLEL_MAKE ?= "-j ${@oe.utils.cpu_count()}"
MACHINE ??= 'cgtqmx6'
DISTRO ?= 'poky'
PACKAGE_CLASSES ?= "package_deb"
EXTRA_IMAGE_FEATURES = "package-management"
USER_CLASSES ?= "buildstats image-mklibs image-prelink rootfs-version"
PATCHRESOLVE = "noop"
BB_DISKMON_DIRS = "\
    STOPTASKS,${TMPDIR},1G,100K \
    STOPTASKS,${DL_DIR},1G,100K \
    STOPTASKS,${SSTATE_DIR},1G,100K \
    ABORT,${TMPDIR},100M,1K \
    ABORT,${DL_DIR},100M,1K \
    ABORT,${SSTATE_DIR},100M,1K"
#PACKAGECONFIG_pn-qemu-native = "sdl"
#ASSUME_PROVIDED += "libsdl-native"
CONF_VERSION = "1"

BB_DANGLINGAPPENDS_WARNONLY = "1"

# limit the default features
DISTRO_FEATURES_DEFAULT = "argp ext2 largefile usbgadget usbhost xattr nfs zeroconf pci sysvinit"

# enable systemd support
#DISTRO_FEATURES_append = "systemd"
#VIRTUAL-RUNTIME_init_manager = "systemd"


BB_NUMBER_THREADS = '8'
PARALLEL_MAKE = '-j 4'

DL_DIR ?= "${BSPDIR}/downloads/"
ACCEPT_FSL_EULA = ""

# Add java license
LICENSE_FLAGS_WHITELIST += "oracle_java"

PARTNUMBER = "PN016104"
# Ensure Hard Float is set
DEFAULTTUNE_mx6 = "cortexa9hf-neon"

#
# Arista necessary packages
#

# Arista necessary packages
IMAGE_INSTALL_append += " \
        apache2 \
        bash \
        bash-completion \
        chkconfig \
	coreutils \
	e2fsprogs \
	e2fsprogs-resize2fs \
	inetutils \
	ifplugd \
	git \
        gcc \
	curl \
	kernel-modules \
	python3 \
	python3-misc \
	python3-modules \
	python3-dev \
	python3-distribute \
	python3-setuptools \
        make \
        nano \
        nginx \
        nodejs \
	ntp \
        oracle-jse-jre \
        packagegroup-core-ssh-openssh \
        perl \
        postgresql \
	postgresql-client \
	postgresql-contrib \
	resolvconf \
        rsync \
        screen \
        sudo \
        service \
	util-linux \
	openssl \
	arista-avahi-configuration \
	arista-usb-automount \
        ntpd-service \
        auto-run-once \
	arista-first-time-install \
	python-pip-installer \
	bootscripts \
"

# RDEPENDS kernel-modules
MACHINE_EXTRA_RDEPENDS += " \
	kernel-modules \
"

# Postgresql preferred version
PREFERRED_VERSION_postgresql = "9.3.5"

# Force makedevs to run
USE_DEVFS="0"

# Root Password
ROOT_PASSWORD = "arista"

IMAGE_PREPROCESS_COMMAND += "update_root_version; "

FILESYSTEM_PERMS_TABLES="/home/yocto/bsp-scripts/arista-server/conf/fs-perms.txt"

# Set the root filesystem size by setting IMAGE_ROOTFS_SIZE
# "524288" is 512 megabytes
# "1048576" is 1 gigabyte
# "1572864" is 1.5 gigabytes

# Use IMAGE_ROOTFS_EXTRA_SPACE to expand the root filesystem for initial deployment purposes.

# enable build history to track changes to rootfs
INHERIT += "buildhistory"
BUILDHISTORY_COMMIT = "1"
```
